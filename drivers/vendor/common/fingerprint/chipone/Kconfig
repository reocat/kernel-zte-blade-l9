## drivers/vendor/common/fingerprint/chipone/Kconfig
```kconfig
#
# chipone Fingerprint driver configuration
#

config PLATFORM_FINGERPRINT_CHIPONE
       tristate "generic chipone fingerprint driver"
       default n
       help
       add support for chipone fingerprint driver.

config FP_PWR_MODE_REGULATOR_VDDCAMMOT
       bool "chipone Fingerprint power regulator vddcammot"
       default n
       help
       CHIPONE Fingerprint power regulator, default GPIO
```

## drivers/vendor/common/fingerprint/fpc/Kconfig
```kconfig
#
# FPC sensors
#

config PLATFORM_FINGERPRINT_FPC
	tristate "fpc fingerprint driver"
	default n
	help
		If you say yes here you get IRQ support for fingerprint
		sensors from Fingerprint Cards (FPC).
```

## drivers/vendor/common/fingerprint/goodix/Kconfig
```kconfig
#
# Goodix Fingerprint driver configuration
#

config PLATFORM_FINGERPRINT_GOODIX
       tristate "generic goodix fingerprint driver"
       default n
       help
       add support for goodix fingerprint driver.

config FP_PWR_MODE_REGULATOR_VDDCAMMOT
       bool "goodix Fingerprint power regulator vddcammot"
       default n
       help
       GOODIX Fingerprint power regulator, default GPIO
```

## drivers/vendor/common/fingerprint/sunwave/Kconfig
```kconfig
#
# sunwave Fingerprint driver configuration
#

config PLATFORM_FINGERPRINT_SUNWAVE
       tristate "generic sunwave fingerprint driver"
       default n
       help
       add support for sunwave fingerprint driver.

config PLATFORM_FINGERPRINT_SUNWAVE_PWR_MODE_REGULATOR
       bool "Sunwave Fingerprint power regulator"
       default n
       help
       SUNWAVECORP Fingerprint power regulator, default GPIO

config FP_PWR_MODE_REGULATOR_VDDCAMMOT
       bool "sunwave Fingerprint power regulator vddcammot"
       default n
       help
       SUNWave Fingerprint power regulator, default GPIO

config SUNWAVE_NAV_REVERT
       bool "sunwave Fingerprint nav revert"
       default n
       help
       SUNWAVE Fingerprint nav revert
```

## drivers/vendor/common/tfa9873/Kconfig
```kconfig
config SND_SOC_TFA98XX
	bool "Support 8350 Goodix smartpa driver"

config SND_SOC_TFA9873
	bool "Support 8250 Goodix smartpa driver"

config SND_SOC_TFA9873_SINGLE
	bool "Support 8250 Goodix smartpa driver" 

config SND_SOC_TFA98XX_SINGLE
	bool "Support 8350 Goodix smartpa driver"
```
