&i2c3 {
	status = "okay";
	clock-frequency = <400000>;

	tlsc6x_ts@2e {
		compatible = "tlsc6x,tlsc6x_ts";
		reg = <0x2e>;
		gpios = <&ap_gpio 145 0
			&ap_gpio 144 0
			&ap_gpio 85 0>;
		TP_MAX_X = <479>;
		TP_MAX_Y = <959>;
	};
};
