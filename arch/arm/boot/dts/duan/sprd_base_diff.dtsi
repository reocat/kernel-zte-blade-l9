/*
 * this file is ued to change sprd dtsi which can't be changed by overlay
 * such as /delete-node/ /delete-property/ and alises
 */

#include "zte_charger_duan.dtsi"
#include "zte_camera_duan.dtsi"
#include "zte_lcd.dtsi"
#include "zte_touchscreen_duan.dtsi"
#include "zte_fingerprint_duan.dtsi"
