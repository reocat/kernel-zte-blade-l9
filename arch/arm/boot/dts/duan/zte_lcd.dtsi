
#include "zte_lcd_lead_st7701s_ctc_5p99_480p.dtsi"
#include "zte_lcd_easyquick_gc9503p_boe_5p99_480p.dtsi"
#include "zte_lcd_coe_st7701s_ivo_5p99_480p.dtsi"
#include "zte_lcd_skyworth_st7701s_boe_5p99_480p.dtsi"
#include "zte_lcd_dummy_mipi.dtsi"
/*
&dphy {
	/delete-property/ sprd,ulps-disabled;
};

&i2c4 {
	ti65132b@3e {
		compatible = "tps,ti65132b";
		reg = <0x3e>;
	};
};
*/

&panel {
	/*iovdd-gpio = <&ap_gpio 62 GPIO_ACTIVE_HIGH>;
	avdd-gpio = <&ap_gpio 4 GPIO_ACTIVE_HIGH>;
	avee-gpio = <&ap_gpio 5 GPIO_ACTIVE_HIGH>;*/
	reset-gpio = <&ap_gpio 50 GPIO_ACTIVE_HIGH>;
};
